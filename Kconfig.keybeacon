## Kconfig.keybeacon
```kconfig
# Copyright (c) 2026 The TOTEM ZMK Contributors
# SPDX-License-Identifier: MIT

config ZMK_KEYBEACON
    bool "KeyBeacon: expose keyboard status (layer+mods) over a custom GATT characteristic"
    depends on ZMK_BLE
    default n

config ZMK_KEYBEACON_CONNECTIVITY
    bool "KeyBeacon 1.1: expose Connectivity characteristic (AA440AA2-…)"
    depends on ZMK_KEYBEACON
    default y
    help
      Emit host-connection, profile, split-link, output-endpoint, and charging-flag
      state on an additional GATT characteristic under the KeyBeacon service. See
      KBP 1.1 §14.3 for the wire contract.

config ZMK_KEYBEACON_BATTERY
    bool "KeyBeacon 1.1: expose Battery characteristic (AA440AA3-…)"
    depends on ZMK_KEYBEACON
    default y
    help
      Emit battery percent(s) on an additional GATT characteristic. Payload is
      1 byte overall on integer boards, 2 bytes [left, right] on splits.
      255 = read failed / temporarily unavailable. See KBP 1.1 §14.4.

config ZMK_KEYBEACON_HOST_LINK
    bool "KeyBeacon 1.2: expose per-connection Host-Link characteristic (AA440AA4-…)"
    depends on ZMK_KEYBEACON_CONNECTIVITY
    default y
    help
      Expose a READ-only GATT characteristic whose value is THIS BLE
      connection's profile slot (byte[0] bits0–6, 1-based; 0 = not
      determined). A GATT read is inherently per-connection, so each bonded
      host learns its own slot with zero configuration, then compares it with
      the broadcast active slot (AA2) to tell "in use here" from "active on
      another computer". The characteristic has no NOTIFY and no CCC, which
      physically rules out broadcast-frame contamination. When the peer cannot
      be resolved to a bonded profile the firmware emits 0 (never a guess).
      Depends on CONNECTIVITY because a host needs AA2's active slot/output to
      make the comparison. See KBP 1.2 §14 (host-link context).


config ZMK_KEYBEACON_ALLOW_INCOMPATIBLE_ZMK
    bool "Allow building against an incompatible ZMK revision (ADVANCED)"
    depends on ZMK_KEYBEACON
    default n
    help
      When enabled, zmk-keybeacon's build-time ZMK revision compatibility
      check (see cmake/zmk_compat.cmake and compatibility.yaml) will emit
      a WARNING instead of a FATAL_ERROR when the installed ZMK revision
      lacks a required internal symbol.

      You almost certainly do NOT want this. The build will continue past
      the configure stage, but will likely fail at C compile time with
      "undefined reference" errors, and the runtime behaviour of the
      KeyBeacon protocol service becomes undefined.

      Enable this only as an emergency bypass while the maintainer
      prepares a patched release.

      Default: n  (fail-fast on incompatible ZMK revisions — recommended)
```
